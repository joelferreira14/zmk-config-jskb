## config/boards/shields/jskb/Kconfig.defconfig
```kconfig
# Copyright (c) 2020 Ryan Cross
# SPDX-License-Identifier: MIT

if SHIELD_JSKB_LEFT

config ZMK_KEYBOARD_NAME
    default "jskb"

config ZMK_SPLIT_ROLE_CENTRAL
    default y

endif

if SHIELD_JSKB_LEFT || SHIELD_JSKB_RIGHT

config ZMK_SPLIT
    default y

endif
```

## config/boards/shields/jskb/Kconfig.shield
```kconfig
# Copyright (c) 2020 Ryan Cross
# SPDX-License-Identifier: MIT

config SHIELD_JSKB_LEFT
    def_bool $(shields_list_contains,jskb_left)

config SHIELD_JSKB_RIGHT
    def_bool $(shields_list_contains,jskb_right)
```
